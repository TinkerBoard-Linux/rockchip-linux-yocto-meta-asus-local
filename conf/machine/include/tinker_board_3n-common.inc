## conf/machine/include/tinker_board_3n-common.inc
```bitbake
ASUS_OVERLAY_DIRS:append = " \
	${TOPDIR}/../../yocto/meta-asus/asus-overlay/overlay \
"

BB_BASEHASH_IGNORE_VARS:append = " ASUS_OVERLAY_DIRS"
ROOTFS_POSTPROCESS_COMMAND:append = " do_asus_post_rootfs;"
do_rootfs[depends] += "rsync-native:do_populate_sysroot"
do_asus_post_rootfs() {
	for overlay in ${ASUS_OVERLAY_DIRS};do
		[ -d "${overlay}" ] || continue
		echo "Installing overlay: ${overlay}..."
		rsync -av --chmod=u=rwX,go=rX "${overlay}/" "${IMAGE_ROOTFS}"
	done

	mv ${IMAGE_ROOTFS}/usr/bin/tinker-config-tb3n ${IMAGE_ROOTFS}/usr/bin/tinker-config
	rm ${IMAGE_ROOTFS}/usr/bin/tinker-config-tb3

	chown -R root:root ${IMAGE_ROOTFS}/etc/sudoers
	chmod -R 440 ${IMAGE_ROOTFS}/etc/sudoers
	chown -R root:root ${IMAGE_ROOTFS}/etc/init.d/triggerhappy
	chmod -R 755 ${IMAGE_ROOTFS}/etc/init.d/triggerhappy
	chown -R root:root ${IMAGE_ROOTFS}/etc/profile.d/ethernet_wol.sh
	chmod -R 755 ${IMAGE_ROOTFS}/etc/profile.d/ethernet_wol.sh
	chown -R root:root ${IMAGE_ROOTFS}/usr/lib/pm-utils/sleep.d/99ethernet_restart
	chmod -R 755 ${IMAGE_ROOTFS}/usr/lib/pm-utils/sleep.d/99ethernet_restart
	chown -R root:root ${IMAGE_ROOTFS}/usr/lib/pm-utils/sleep.d/02pulseaudio-resume
	chmod -R 755 ${IMAGE_ROOTFS}/usr/lib/pm-utils/sleep.d/02pulseaudio-resume
	chown -R root:root ${IMAGE_ROOTFS}/etc/udev/rules.d/60-drm.rules
	chmod -R 755 ${IMAGE_ROOTFS}/etc/udev/rules.d/60-drm.rules
	chown -R root:root ${IMAGE_ROOTFS}/usr/bin/drm-hotplug.sh
	chmod -R 755 ${IMAGE_ROOTFS}/usr/bin/drm-hotplug.sh
	chown -R root:root ${IMAGE_ROOTFS}/etc/pulse/jack_hotplug.sh
	chmod -R 755 ${IMAGE_ROOTFS}/etc/pulse/jack_hotplug.sh
	chown -R root:root ${IMAGE_ROOTFS}/etc/pulse/switch_sound_device.sh
	chmod -R 755 ${IMAGE_ROOTFS}/etc/pulse/switch_sound_device.sh
	chown -R root:root ${IMAGE_ROOTFS}/etc/profile.d/switch_sound_device_boot.sh
	chmod -R 755 ${IMAGE_ROOTFS}/etc/profile.d/switch_sound_device_boot.sh
	chown -R root:root ${IMAGE_ROOTFS}/etc/wireplumber/jack_hotplug.sh
	chmod -R 755 ${IMAGE_ROOTFS}/etc/wireplumber/jack_hotplug.sh
	rm -rf ${IMAGE_ROOTFS}/userdata
	ln -s -r ${IMAGE_ROOTFS}/boot ${IMAGE_ROOTFS}/userdata
	rm -rf ${IMAGE_ROOTFS}/tmp
	ln -s -r ${IMAGE_ROOTFS}/var/tmp ${IMAGE_ROOTFS}/tmp
}

ASUS_OVERLAY_DEBUG_DIRS:append = " \
	${TOPDIR}/../../yocto/meta-asus/asus-overlay/overlay-debug \
"

BB_BASEHASH_IGNORE_VARS:append = " ASUS_OVERLAY_DEBUG_DIRS"
ROOTFS_POSTPROCESS_COMMAND:append = " do_asus_post_rootfs_debug;"
do_asus_post_rootfs_debug() {
	image_type=`echo ${IMAGE_VERSION} | awk -F '_' '{print $NF}'`
	if [ "$image_type" != "release" ]; then
		for overlay in ${ASUS_OVERLAY_DEBUG_DIRS};do
			[ -d "${overlay}" ] || continue
			echo "Installing overlay: ${overlay}..."
			rsync -av --chmod=u=rwX,go=rX "${overlay}/" "${IMAGE_ROOTFS}"
		done

		if [ -e ${IMAGE_ROOTFS}/home/root/Test_tool_${RK_PROJECT_NAME} ]; then
        		mv ${IMAGE_ROOTFS}/home/root/Test_tool_${RK_PROJECT_NAME} ${IMAGE_ROOTFS}/home/root/Test_tool 
		fi

		if [ -z $(find "${IMAGE_ROOTFS}/home/root/" -name "Test_tool_*") ]; then
			echo "No other project Test tool"
		else
                        echo "Remove other project Test tool"
			rm -rf ${IMAGE_ROOTFS}/home/root/Test_tool_*
                fi

	fi
}
```

## conf/machine/rockchip-rk3566-tinker_board_3.conf
```bitbake
# Copyright (c) 2019, Fuzhou Rockchip Electronics Co., Ltd
# Released under the MIT license (see COPYING.MIT for the terms)

#@TYPE: Machine
#@NAME: RK3566 Tinker Board 3

require conf/machine/include/rk356x.inc
require conf/machine/include/tinker_board_3-common.inc

KERNEL_DEVICETREE = "rockchip/rk3566-tinker_board_3.dtb"

UBOOT_MACHINE = "tinker_board_3_defconfig"

KBUILD_DEFCONFIG = "tinker_board_3_defconfig"

BB_NUMBER_THREADS = "8"
PARALLEL_MAKE = "-j 8"

RK_WIFIBT_FIRMWARES = " \
        rkwifibt-firmware-ap6398s-wifi \
        rkwifibt-firmware-ap6398s-bt \
        brcm-tools \
"

DISTRO_FEATURES:append = " virtualization"

MACHINE_EXTRA_RRECOMMENDS:append = " \
        drm-cursor \
        vim \
        exfat-utils \
        fuse-exfat \
        ntfs-3g \
        gptfdisk \
        usbutils \
        ntpdate \
        ntp \
        triggerhappy \
        pciutils \
        parted \
        asus-init \
        lte-init \
"

IMAGE_INSTALL:append = " \
	ntpdate \
	networkmanager \
	networkmanager-nmcli \
	networkmanager-nmtui \
	networkmanager-wwan \
	networkmanager-ppp \
	xmlto \
	bash-completion \
	whiptail \
	sudo \
	pm-utils \
	curl \
	iperf3 \
	python3 \
	python3-pip \
	v4l-utils \
	mraa \
	ethtool \
	packagegroup-tools-bluetooth \
	i2c-tools \
	glibc-gconv-utf-16 \
	evtest \
	can-utils \
	sysbench \
	python3-requests \
	docker-ce \
	net-tools \
"

PACKAGECONFIG:append:pn-networkmanager = " modemmanager ppp"
PACKAGECONFIG:append:pn-modemmanager = " at"
```

## conf/machine/rockchip-rk3568-tinker_board_3n.conf
```bitbake
# Copyright (c) 2019, Fuzhou Rockchip Electronics Co., Ltd
# Released under the MIT license (see COPYING.MIT for the terms)

#@TYPE: Machine
#@NAME: RK3568 Tinker Board 3N

require conf/machine/include/rk356x.inc
require conf/machine/include/tinker_board_3n-common.inc

KERNEL_DEVICETREE = "rockchip/rk3568-tinker_board_3n.dtb"

UBOOT_MACHINE = "tinker_board_3n_defconfig"

KBUILD_DEFCONFIG = "tinker_board_3n_defconfig"

BB_NUMBER_THREADS = "8"
PARALLEL_MAKE = "-j 8"

RK_WIFIBT_FIRMWARES = " \
        rkwifibt-firmware-ap6398s-wifi \
        rkwifibt-firmware-ap6398s-bt \
        brcm-tools \
"

DISTRO_FEATURES:append = " virtualization"

MACHINE_EXTRA_RRECOMMENDS:append = " \
        drm-cursor \
        vim \
        gptfdisk \
        usbutils \
        ntp \
        triggerhappy \
        pciutils \
        parted \
        asus-init \
        lte-init \
"

IMAGE_INSTALL:append = " \
	networkmanager \
	networkmanager-nmcli \
	networkmanager-wwan \
	networkmanager-ppp \
	xmlto \
	bash-completion \
	whiptail \
	sudo \
	pm-utils \
	curl \
	iperf3 \
	python3 \
	python3-pip \
	v4l-utils \
	mraa \
	ethtool \
	packagegroup-tools-bluetooth \
	i2c-tools \
	glibc-gconv-utf-16 \
	evtest \
	can-utils \
	sysbench \
	python3-requests \
        docker \
        docker-compose \
        nodejs \
"

PACKAGECONFIG:append:pn-networkmanager = " modemmanager ppp nmtui wwan"
PACKAGECONFIG:append:pn-modemmanager = " at"
```
